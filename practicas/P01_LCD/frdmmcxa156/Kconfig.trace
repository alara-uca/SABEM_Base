## practicas/P01_LCD/frdmmcxa156/Kconfig.trace
```kconfig
config CUSTOM_APP_FLEXIO_MCULCD_EDMA_TRANSFER
    bool
    default y
    select MCUX_PRJSEG_config.arm.warn_as_error
    select MCUX_PRJSEG_config.arm.shared
    select MCUX_PRJSEG_config.mcx.shared
    select MCUX_PRJSEG_config.device_core.define
    select MCUX_PRJSEG_config.arm.core.fpu.fpv5_sp
    select MCUX_PRJSEG_config.arm.core.cm33_dsp_nosau
    select MCUX_COMPONENT_CMSIS_Include_core_cm
    select MCUX_PRJSEG_module.device.suite
    select MCUX_COMPONENT_driver.video-common
    select MCUX_COMPONENT_driver.dbi
```

## practicas/P01_LCD/modulos/comun/mcux/Kconfig
```kconfig
config MCUX_COMPONENT_COMUN
    bool "Definiciones comunes de la asignatura (tipos.h)"
    select MCUX_COMPONENT_driver.common
    help
      Tipos y macros comunes a todos los módulos. Lo activan solos los módulos que lo necesitan.
```

## practicas/P01_LCD/modulos/lcd/lcd/mcux/Kconfig
```kconfig
config MCUX_COMPONENT_LCD
    bool "Biblioteca lcd_ (pantalla LCD-PAR-S035, modo inmediato)"
    select MCUX_COMPONENT_COMUN
    select MCUX_COMPONENT_LCD_PANEL
    help
      Texto con tres fuentes, figuras y colores en la pantalla de 480 x 320, dibujando
      directamente en la memoria del ST7796S. Sin LVGL.
```

## practicas/P01_LCD/modulos/lcd/lcd_lvgl/mcux/Kconfig
```kconfig
config MCUX_COMPONENT_LCD_LVGL
    bool "Biblioteca lcd_lvgl_ (modo inmediato emulado sobre LVGL 9.4)"
    select MCUX_COMPONENT_COMUN
    select MCUX_COMPONENT_LCD_PANEL
    select MCUX_COMPONENT_LCD_TACTIL
    select MCUX_COMPONENT_middleware.lvgl
    help
      Mismas funciones que lcd_ con prefijo lcd_lvgl_, pero cada llamada crea un objeto de LVGL.
      Incluye el port de LVGL (display con búferes parciales + táctil) y su lv_conf.h, que
      sustituye al de la plantilla del SDK.

if MCUX_COMPONENT_LCD_LVGL

config LV_CONF_PATH
    string
    default "lv_conf.h"
    help
      No prefix in generated macro
      Macro value is in quotes

      En el SDK, LVGL se configura por Kconfig (LV_CONF_SKIP=y) e ignora lv_conf.h. Con
      LV_CONF_PATH definido, LVGL incluye el lv_conf.h de este módulo igualmente: lo que se define
      en él tiene prioridad y el resto de opciones sale de Kconfig (prj.conf, CONFIG_LV_*).

config LCD_LVGL_PILA_PRINCIPAL
    hex "Tamaño de la pila principal (bytes)"
    default 0x1800
    help
      Sin RTOS, LVGL dibuja en la pila de main(), y los 2 KiB (0x800) del proyecto no bastan: se
      desborda y salta un HardFault (pantalla en negro). 0x1800 es lo que usan los ejemplos LVGL
      sin RTOS de NXP para esta placa (lvgl_demo_widgets_bm). Con FreeRTOS, LVGL dibuja en su
      propia tarea, pero la pila principal la siguen usando las interrupciones.

config LCD_LVGL_PORT_SYSTICK_PROPIO
    int "Sin FreeRTOS: el port usa el SysTick como reloj de LVGL (1 = sí, 0 = no)"
    range 0 1
    default 1
    help
      No prefix in generated macro

      Con 1, lcd_lvgl_port define SysTick_Handler(). Si el programa ya usa el SysTick, poner 0 y
      llamar a lcd_lvgl_port_contar_1ms() cada milisegundo. Con FreeRTOS no se usa.

config LCD_LVGL_PORT_INTERCAMBIAR_BYTES
    int "Intercambiar los bytes de cada píxel RGB565 antes de enviarlos (1 = sí, 0 = no)"
    range 0 1
    default 0
    help
      No prefix in generated macro

endif
```

## practicas/P01_LCD/modulos/lcd/lcd_panel/mcux/Kconfig
```kconfig
config MCUX_COMPONENT_LCD_PANEL
    bool "Capa baja de la pantalla LCD-PAR-S035 (ST7796S por FlexIO)"
    select MCUX_COMPONENT_COMUN
    select MCUX_COMPONENT_driver.common
    select MCUX_COMPONENT_driver.clock
    select MCUX_COMPONENT_driver.reset
    select MCUX_COMPONENT_driver.port
    select MCUX_COMPONENT_driver.gpio
    select MCUX_COMPONENT_driver.flexio
    select MCUX_COMPONENT_driver.flexio_mculcd
    select MCUX_COMPONENT_driver.flexio_mculcd_edma
    select MCUX_COMPONENT_driver.st7796s
    select MCUX_COMPONENT_driver.dbi_flexio_edma
    help
      Única dueña del ST7796S y del bus 8080 del FlexIO. La usan lcd, lcd_tactil y lcd_lvgl;
      no hace falta activarla a mano.

if MCUX_COMPONENT_LCD_PANEL

config LCD_PANEL_CON_FREERTOS
    bool "Proteger el bus de la pantalla con un mutex de FreeRTOS"
    default y if MCUX_COMPONENT_middleware.freertos-kernel
    help
      No prefix in generated macro

      Se activa sola si el proyecto usa FreeRTOS. Genera la macro global LCD_PANEL_CON_FREERTOS,
      que leen lcd_panel.c, lcd_lvgl_port.c y lv_conf.h.

endif
```

## practicas/P01_LCD/modulos/lcd/lcd_tactil/mcux/Kconfig
```kconfig
config MCUX_COMPONENT_LCD_TACTIL
    bool "Panel táctil GT911 de la pantalla LCD-PAR-S035 (LPI2C2)"
    select MCUX_COMPONENT_COMUN
    select MCUX_COMPONENT_LCD_PANEL
    select MCUX_COMPONENT_driver.common
    select MCUX_COMPONENT_driver.clock
    select MCUX_COMPONENT_driver.reset
    select MCUX_COMPONENT_driver.port
    select MCUX_COMPONENT_driver.lpi2c
    select MCUX_COMPONENT_driver.gt911
    help
      lcd_tactil_leer(&x, &y) en modo inmediato. Necesita lcd_panel porque el reset del GT911
      va unido al del ST7796S. También es el que usa lcd_lvgl como dispositivo de entrada.
```
